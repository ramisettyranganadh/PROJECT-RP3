## meta-application/conf/layer.conf
```bitbake
# We have a conf and classes directory, add to BBPATH
BBPATH .= ":${LAYERDIR}"

# We have recipes-* directories, add to BBFILES
BBFILES += "${LAYERDIR}/recipes-*/*/*.bb \
            ${LAYERDIR}/recipes-*/*/*.bbappend"

BBFILE_COLLECTIONS += "meta-application"
BBFILE_PATTERN_meta-application = "^${LAYERDIR}/"
BBFILE_PRIORITY_meta-application = "6"

LAYERDEPENDS_meta-application = "core"
LAYERSERIES_COMPAT_meta-application = "scarthgap"
```

## meta-dataloader/conf/layer.conf
```bitbake
# We have a conf and classes directory, add to BBPATH
BBPATH .= ":${LAYERDIR}"

# We have recipes-* directories, add to BBFILES
BBFILES += "${LAYERDIR}/recipes-*/*/*.bb \
            ${LAYERDIR}/recipes-*/*/*.bbappend"

BBFILE_COLLECTIONS += "meta-dataloader"
BBFILE_PATTERN_meta-dataloader = "^${LAYERDIR}/"
BBFILE_PRIORITY_meta-dataloader = "6"

LAYERDEPENDS_meta-dataloader = "core"
LAYERSERIES_COMPAT_meta-dataloader = "scarthgap"
```

## meta-platform/conf/layer.conf
```bitbake
# We have a conf and classes directory, add to BBPATH
BBPATH .= ":${LAYERDIR}"

# We have recipes-* directories, add to BBFILES
BBFILES += "${LAYERDIR}/recipes-*/*/*.bb \
            ${LAYERDIR}/recipes-*/*/*.bbappend"

BBFILE_COLLECTIONS += "meta-platform"
BBFILE_PATTERN_meta-platform = "^${LAYERDIR}/"
BBFILE_PRIORITY_meta-platform = "6"

LAYERDEPENDS_meta-platform = "core"
LAYERSERIES_COMPAT_meta-platform = "scarthgap"
```
